## porting_workspace/linux_kernel_patch/Documentation/devicetree/bindings/arm/asr/ooredoo-r291-v2.yaml
```yaml
# SPDX-License-Identifier: (GPL-2.0 OR BSD-2-Clause)
title: Ooredoo R291 v2 (ASR 1826s / KAGU)

maintainer: R291 porting project <your@email>

description:
  Ooredoo R291 v2 IAD gateway built on the ASR Microelectronics ASR1802S
  SoC (single Cortex-A9, 128 MiB RAM).  The board is referred to as
  "KAGU" / "ASR 1826s (KAGU) Board EVB" in the vendor device tree and
  U-Boot bootargs.

  Hardware summary (extracted from the running unit, kernel 3.10.33):
    - SoC            : ASR1802S (compatible "asr,1802s-evb","asr,1802s")
    - CPU            : ARMv7-Cortex-A9 @ ~1 GHz
    - Flash          : 128 MiB SPI-NAND (F35UQA001G, 128 KiB erase) A/B dual-bank + UBI overlay
    - RAM            : 128 MiB (32 MiB reserved for the CP)
    - Console        : ttyS0 @ 115200n8 (pxa2xx-uart, MMIO 0xd4017000, irq 59)
    - WiFi           : 2x Realtek RTL8812FE on PCIe gen1x1 (vendor driver rtl8192cd.ko)
    - Ethernet       : ASR MAC @ 0xd4281800 (irq 42/43) + YT9215 switch
    - USB3           : DWC3 (irq 76) + ASR USB3 PHY @ c0030000
    - MMC            : mmc0 @ 0xd4280000 (irq 71)
    - PMIC           : 88PM802 on I2C@0x30 (d4037000, irq 12089)
    - VoIP           : MAX1919/SLIC (GPIO23 reset, GPIO24 wakeup) — 2 FXS
    - U-Boot         : Marvell "mrvlboot", bootdelay=1, verify=no, loadaddr=0x8000

  NOTE: WiFi is served by the proprietary rtl8192cd (binary-only, kernel 3.10).
  The in-tree rtw88 driver supports RTL8812FE as of Linux 5.13+ and is the
  intended replacement; until the SoC port lands, WiFi must remain on the
  vendor kernel fork.

properties:
  compatible:
    description: Root compatible must include the SoC strings exposed by the
      shipped device tree so the DTB matches the running hardware.
    oneOf:
      - items:
          - const: asr,1802s-evb
          - const: asr,1802s
    deprecated:
      - description: "ooredoo,r291-v2"   # alias for future machine matching

  soc:
    description: "KAGU board peripherals are sub-nodes of the ASR1802S SoC."
    $ref: /schemas/soc/asr/asr1802s.yaml#

required:
  - compatible

unevaluatedProperties: false

examples:
  - |
    #include "asr1826s-kagu.dts"
```
